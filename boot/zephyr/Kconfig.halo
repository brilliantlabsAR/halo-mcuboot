## boot/zephyr/Kconfig.halo
```kconfig
if HALO

config BOOT_BLE_DFU_ENTRANCE_GPIO
    bool "BLE DFU entrance via GPIO"
    depends on GPIO
    help
      Use a GPIO to enter BLE DFU mode.

endif
```

## boot/zephyr/boards/halo.conf
```kconfig
# Bluetooth Configuration
CONFIG_BT=y
CONFIG_BT_CUSTOM=y

CONFIG_LOG=n

# OTA Configuration
CONFIG_NET_BUF=y
CONFIG_ZCBOR=y
CONFIG_MCUMGR=y
CONFIG_IMG_MANAGER=y
CONFIG_MCUMGR_GRP_IMG=y
CONFIG_MCUMGR_GRP_OS=y
CONFIG_MCUMGR_TRANSPORT_NETBUF_SIZE=517

# Flash Configuration
CONFIG_STREAM_FLASH=y
CONFIG_FLASH=y
CONFIG_FLASH_MAP=y
CONFIG_FLASH_PAGE_LAYOUT=y
CONFIG_MPU_ALLOW_FLASH_WRITE=y

CONFIG_SETTINGS_FILE_PATH="/lfs/settings"

# LED Configuration
CONFIG_PWM=y
CONFIG_LED_PWM=y

# Enable MCUBOOT Bootloader
CONFIG_HALO=y

# MCUBOOT Configuration
CONFIG_BOOT_MAX_IMG_SECTORS=843
CONFIG_MCUBOOT_INDICATION_LED=y
CONFIG_BOOT_BLE_DFU_ENTRANCE_GPIO=y

CONFIG_REGULATOR_TPS65132=n
CONFIG_BOOT_BANNER=n
CONFIG_I2S_SYNC=n

CONFIG_ALIF_BLE_HOST_THREAD_PRIORITY=1
CONFIG_ALIF_BLE_HOST_THREAD_STACKSIZE=10240
CONFIG_ALIF_BLE_HOST_ADDL_PRF_HEAPSIZE=10240
CONFIG_ALIF_BLE_HOST_ADDL_ENV_HEAPSIZE=8192
```

## boot/zephyr/boards/mk5.conf
```kconfig
# Bluetooth Configuration
CONFIG_BT=y
CONFIG_BT_CUSTOM=y

CONFIG_LOG=n

# OTA Configuration
CONFIG_NET_BUF=y
CONFIG_ZCBOR=y
CONFIG_MCUMGR=y
CONFIG_IMG_MANAGER=y
CONFIG_MCUMGR_GRP_IMG=y
CONFIG_MCUMGR_GRP_OS=y
CONFIG_MCUMGR_TRANSPORT_NETBUF_SIZE=517

# Flash Configuration
CONFIG_STREAM_FLASH=y
CONFIG_FLASH_MAP=y
CONFIG_FLASH=y

# LED Configuration
CONFIG_PWM=y
CONFIG_LED_PWM=y

# Enable MCUBOOT Bootloader
CONFIG_HALO=y

# MCUBOOT Configuration
CONFIG_BOOT_MAX_IMG_SECTORS=843
CONFIG_MCUBOOT_INDICATION_LED=y
CONFIG_BOOT_BLE_DFU_ENTRANCE_GPIO=y

CONFIG_REGULATOR_TPS65132=y
CONFIG_BOOT_BANNER=n
CONFIG_I2S_SYNC=n
```
